## twister-out_l8-task2/native_sim_native/host_gnu/tests/temp_alarm/homework.unit.temp_alarm.ordered/Kconfig/arch/Kconfig
```kconfig
# Load Zephyr Arch Kconfig descriptions.
osource "/home/raul/iomico_inter/zephyr-intermediate/zephyr/arch/rx/Kconfig"
osource "/home/raul/iomico_inter/zephyr-intermediate/zephyr/arch/x86/Kconfig"
osource "/home/raul/iomico_inter/zephyr-intermediate/zephyr/arch/xtensa/Kconfig"
osource "/home/raul/iomico_inter/zephyr-intermediate/zephyr/arch/sparc/Kconfig"
osource "/home/raul/iomico_inter/zephyr-intermediate/zephyr/arch/riscv/Kconfig"
osource "/home/raul/iomico_inter/zephyr-intermediate/zephyr/arch/posix/Kconfig"
osource "/home/raul/iomico_inter/zephyr-intermediate/zephyr/arch/openrisc/Kconfig"
osource "/home/raul/iomico_inter/zephyr-intermediate/zephyr/arch/mips/Kconfig"
osource "/home/raul/iomico_inter/zephyr-intermediate/zephyr/arch/arm64/Kconfig"
osource "/home/raul/iomico_inter/zephyr-intermediate/zephyr/arch/arm/Kconfig"
osource "/home/raul/iomico_inter/zephyr-intermediate/zephyr/arch/arc/Kconfig"
```

## twister-out_l8-task2/native_sim_native/host_gnu/tests/temp_alarm/homework.unit.temp_alarm/Kconfig/boards/Kconfig.defconfig
```kconfig
# Load Zephyr board defconfig descriptions.
osource "/home/raul/iomico_inter/zephyr-intermediate/zephyr/boards/native/native_sim/Kconfig.defconfig"
```

## twister-out_l8_task1/native_sim_native/host_gnu/tests/temp_alarm/homework.unit.temp_alarm/Kconfig/boards/Kconfig.tmp
```kconfig
# Load Zephyr board Kconfig descriptions.
osource "/home/raul/iomico_inter/zephyr-intermediate/zephyr/boards/native/native_sim/Kconfig"
```

## twister-out_l8_task1/native_sim_native/host_gnu/tests/temp_alarm/homework.unit.temp_alarm/Kconfig/soc/Kconfig
```kconfig
# Load Zephyr SoC Kconfig descriptions.
osource "/home/raul/iomico_inter/zephyr-intermediate/zephyr/soc/xlnx/zynqmp/Kconfig"
osource "/home/raul/iomico_inter/zephyr-intermediate/zephyr/soc/xlnx/zynq7000/Kconfig"
osource "/home/raul/iomico_inter/zephyr-intermediate/zephyr/soc/xlnx/versalnet/Kconfig"
osource "/home/raul/iomico_inter/zephyr-intermediate/zephyr/soc/xlnx/versal2/Kconfig"
osource "/home/raul/iomico_inter/zephyr-intermediate/zephyr/soc/xlnx/versal/Kconfig"
osource "/home/raul/iomico_inter/zephyr-intermediate/zephyr/soc/xen/Kconfig"
osource "/home/raul/iomico_inter/zephyr-intermediate/zephyr/soc/wch/ch32v/Kconfig"
osource "/home/raul/iomico_inter/zephyr-intermediate/zephyr/soc/ti/simplelink/Kconfig"
osource "/home/raul/iomico_inter/zephyr-intermediate/zephyr/soc/ti/mspm0/Kconfig"
osource "/home/raul/iomico_inter/zephyr-intermediate/zephyr/soc/ti/lm3s6965/Kconfig"
osource "/home/raul/iomico_inter/zephyr-intermediate/zephyr/soc/ti/k3/Kconfig"
osource "/home/raul/iomico_inter/zephyr-intermediate/zephyr/soc/telink/tlsr/Kconfig"
osource "/home/raul/iomico_inter/zephyr-intermediate/zephyr/soc/syna/sr100/Kconfig"
osource "/home/raul/iomico_inter/zephyr-intermediate/zephyr/soc/starfive/jh71xx/Kconfig"
osource "/home/raul/iomico_inter/zephyr-intermediate/zephyr/soc/st/stm32/Kconfig"
osource "/home/raul/iomico_inter/zephyr-intermediate/zephyr/soc/snps/qemu_arc/Kconfig"
osource "/home/raul/iomico_inter/zephyr-intermediate/zephyr/soc/snps/nsim/arc_v/Kconfig"
osource "/home/raul/iomico_inter/zephyr-intermediate/zephyr/soc/snps/nsim/arc_classic/Kconfig"
osource "/home/raul/iomico_inter/zephyr-intermediate/zephyr/soc/snps/hsdk4xd/Kconfig"
osource "/home/raul/iomico_inter/zephyr-intermediate/zephyr/soc/snps/hsdk/Kconfig"
osource "/home/raul/iomico_inter/zephyr-intermediate/zephyr/soc/snps/emsk/Kconfig"
osource "/home/raul/iomico_inter/zephyr-intermediate/zephyr/soc/snps/emsdp/Kconfig"
osource "/home/raul/iomico_inter/zephyr-intermediate/zephyr/soc/snps/arc_iot/Kconfig"
osource "/home/raul/iomico_inter/zephyr-intermediate/zephyr/soc/silabs/Kconfig"
osource "/home/raul/iomico_inter/zephyr-intermediate/zephyr/soc/sifli/sf32/Kconfig"
osource "/home/raul/iomico_inter/zephyr-intermediate/zephyr/soc/sifive/sifive_freedom/Kconfig"
osource "/home/raul/iomico_inter/zephyr-intermediate/zephyr/soc/sensry/Kconfig"
osource "/home/raul/iomico_inter/zephyr-intermediate/zephyr/soc/rockchip/Kconfig"
osource "/home/raul/iomico_inter/zephyr-intermediate/zephyr/soc/renode/riscv_virtual/Kconfig"
osource "/home/raul/iomico_inter/zephyr-intermediate/zephyr/soc/renode/cortex_r8_virtual/Kconfig"
osource "/home/raul/iomico_inter/zephyr-intermediate/zephyr/soc/renesas/smartbond/Kconfig"
osource "/home/raul/iomico_inter/zephyr-intermediate/zephyr/soc/renesas/rz/Kconfig"
osource "/home/raul/iomico_inter/zephyr-intermediate/zephyr/soc/renesas/rx/Kconfig"
osource "/home/raul/iomico_inter/zephyr-intermediate/zephyr/soc/renesas/rcar/Kconfig"
osource "/home/raul/iomico_inter/zephyr-intermediate/zephyr/soc/renesas/ra/Kconfig"
osource "/home/raul/iomico_inter/zephyr-intermediate/zephyr/soc/realtek/fingerprint/Kconfig"
osource "/home/raul/iomico_inter/zephyr-intermediate/zephyr/soc/realtek/ec/Kconfig"
osource "/home/raul/iomico_inter/zephyr-intermediate/zephyr/soc/realtek/bee/Kconfig"
osource "/home/raul/iomico_inter/zephyr-intermediate/zephyr/soc/realtek/ameba/Kconfig"
osource "/home/raul/iomico_inter/zephyr-intermediate/zephyr/soc/raspberrypi/rpi_pico/Kconfig"
osource "/home/raul/iomico_inter/zephyr-intermediate/zephyr/soc/quicklogic/eos_s3/Kconfig"
osource "/home/raul/iomico_inter/zephyr-intermediate/zephyr/soc/qemu/virt_riscv/Kconfig"
osource "/home/raul/iomico_inter/zephyr-intermediate/zephyr/soc/qemu/or1k/Kconfig"
osource "/home/raul/iomico_inter/zephyr-intermediate/zephyr/soc/qemu/malta/Kconfig"
osource "/home/raul/iomico_inter/zephyr-intermediate/zephyr/soc/openisa/rv32m1/Kconfig"
osource "/home/raul/iomico_inter/zephyr-intermediate/zephyr/soc/openhwgroup/cva6/Kconfig"
osource "/home/raul/iomico_inter/zephyr-intermediate/zephyr/soc/oct/osd32mp15x/Kconfig"
osource "/home/raul/iomico_inter/zephyr-intermediate/zephyr/soc/nxp/s32/Kconfig"
osource "/home/raul/iomico_inter/zephyr-intermediate/zephyr/soc/nxp/rw/Kconfig"
osource "/home/raul/iomico_inter/zephyr-intermediate/zephyr/soc/nxp/mcx/Kconfig"
osource "/home/raul/iomico_inter/zephyr-intermediate/zephyr/soc/nxp/lpc/Kconfig"
osource "/home/raul/iomico_inter/zephyr-intermediate/zephyr/soc/nxp/layerscape/Kconfig"
osource "/home/raul/iomico_inter/zephyr-intermediate/zephyr/soc/nxp/kinetis/Kconfig"
osource "/home/raul/iomico_inter/zephyr-intermediate/zephyr/soc/nxp/imxrt/Kconfig"
osource "/home/raul/iomico_inter/zephyr-intermediate/zephyr/soc/nxp/imx/Kconfig"
osource "/home/raul/iomico_inter/zephyr-intermediate/zephyr/soc/nuvoton/numicro/Kconfig"
osource "/home/raul/iomico_inter/zephyr-intermediate/zephyr/soc/nuvoton/numaker/Kconfig"
osource "/home/raul/iomico_inter/zephyr-intermediate/zephyr/soc/nuvoton/npcx/Kconfig"
osource "/home/raul/iomico_inter/zephyr-intermediate/zephyr/soc/nuvoton/npcm/Kconfig"
osource "/home/raul/iomico_inter/zephyr-intermediate/zephyr/soc/nordic/Kconfig"
osource "/home/raul/iomico_inter/zephyr-intermediate/zephyr/soc/neorv32/Kconfig"
osource "/home/raul/iomico_inter/zephyr-intermediate/zephyr/soc/native/inf_clock/Kconfig"
osource "/home/raul/iomico_inter/zephyr-intermediate/zephyr/soc/microchip/sam/sama7/Kconfig"
osource "/home/raul/iomico_inter/zephyr-intermediate/zephyr/soc/microchip/sam/sam_d5x_e5x/Kconfig"
osource "/home/raul/iomico_inter/zephyr-intermediate/zephyr/soc/microchip/pic64/Kconfig"
osource "/home/raul/iomico_inter/zephyr-intermediate/zephyr/soc/microchip/pic32c/pic32cz_ca/Kconfig"
osource "/home/raul/iomico_inter/zephyr-intermediate/zephyr/soc/microchip/pic32c/pic32cx_sg/Kconfig"
osource "/home/raul/iomico_inter/zephyr-intermediate/zephyr/soc/microchip/pic32c/pic32cm_pl/Kconfig"
osource "/home/raul/iomico_inter/zephyr-intermediate/zephyr/soc/microchip/pic32c/pic32cm_jh/Kconfig"
osource "/home/raul/iomico_inter/zephyr-intermediate/zephyr/soc/microchip/miv/Kconfig"
osource "/home/raul/iomico_inter/zephyr-intermediate/zephyr/soc/microchip/mec/Kconfig"
osource "/home/raul/iomico_inter/zephyr-intermediate/zephyr/soc/mediatek/mt8xxx/Kconfig"
osource "/home/raul/iomico_inter/zephyr-intermediate/zephyr/soc/lowrisc/opentitan/Kconfig"
osource "/home/raul/iomico_inter/zephyr-intermediate/zephyr/soc/litex/litex_vexriscv/Kconfig"
osource "/home/raul/iomico_inter/zephyr-intermediate/zephyr/soc/ite/ec/Kconfig"
osource "/home/raul/iomico_inter/zephyr-intermediate/zephyr/soc/intel/wildcat_lake/Kconfig"
osource "/home/raul/iomico_inter/zephyr-intermediate/zephyr/soc/intel/raptor_lake/Kconfig"
osource "/home/raul/iomico_inter/zephyr-intermediate/zephyr/soc/intel/panther_lake/Kconfig"
osource "/home/raul/iomico_inter/zephyr-intermediate/zephyr/soc/intel/lakemont/Kconfig"
osource "/home/raul/iomico_inter/zephyr-intermediate/zephyr/soc/intel/intel_socfpga_std/Kconfig"
osource "/home/raul/iomico_inter/zephyr-intermediate/zephyr/soc/intel/intel_socfpga/Kconfig"
osource "/home/raul/iomico_inter/zephyr-intermediate/zephyr/soc/intel/intel_niosv/Kconfig"
osource "/home/raul/iomico_inter/zephyr-intermediate/zephyr/soc/intel/intel_ish/Kconfig"
osource "/home/raul/iomico_inter/zephyr-intermediate/zephyr/soc/intel/intel_adsp/Kconfig"
osource "/home/raul/iomico_inter/zephyr-intermediate/zephyr/soc/intel/elkhart_lake/Kconfig"
osource "/home/raul/iomico_inter/zephyr-intermediate/zephyr/soc/intel/atom/Kconfig"
osource "/home/raul/iomico_inter/zephyr-intermediate/zephyr/soc/intel/apollo_lake/Kconfig"
osource "/home/raul/iomico_inter/zephyr-intermediate/zephyr/soc/intel/alder_lake/Kconfig"
osource "/home/raul/iomico_inter/zephyr-intermediate/zephyr/soc/infineon/psoc4/Kconfig"
osource "/home/raul/iomico_inter/zephyr-intermediate/zephyr/soc/infineon/edge/Kconfig"
osource "/home/raul/iomico_inter/zephyr-intermediate/zephyr/soc/infineon/cat3/Kconfig"
osource "/home/raul/iomico_inter/zephyr-intermediate/zephyr/soc/infineon/cat1c/Kconfig"
osource "/home/raul/iomico_inter/zephyr-intermediate/zephyr/soc/infineon/cat1b/Kconfig"
osource "/home/raul/iomico_inter/zephyr-intermediate/zephyr/soc/infineon/cat1a/Kconfig"
osource "/home/raul/iomico_inter/zephyr-intermediate/zephyr/soc/gd/gd32/Kconfig"
osource "/home/raul/iomico_inter/zephyr-intermediate/zephyr/soc/gaisler/leon3/Kconfig"
osource "/home/raul/iomico_inter/zephyr-intermediate/zephyr/soc/gaisler/gr716a/Kconfig"
osource "/home/raul/iomico_inter/zephyr-intermediate/zephyr/soc/focaltech/Kconfig"
osource "/home/raul/iomico_inter/zephyr-intermediate/zephyr/soc/espressif/Kconfig"
osource "/home/raul/iomico_inter/zephyr-intermediate/zephyr/soc/ene/kb1200/Kconfig"
osource "/home/raul/iomico_inter/zephyr-intermediate/zephyr/soc/ene/kb106x/Kconfig"
osource "/home/raul/iomico_inter/zephyr-intermediate/zephyr/soc/elan/em32f967/Kconfig"
osource "/home/raul/iomico_inter/zephyr-intermediate/zephyr/soc/egis/Kconfig"
osource "/home/raul/iomico_inter/zephyr-intermediate/zephyr/soc/efinix/sapphire/Kconfig"
osource "/home/raul/iomico_inter/zephyr-intermediate/zephyr/soc/cdns/xtensa_sample_controller/Kconfig"
osource "/home/raul/iomico_inter/zephyr-intermediate/zephyr/soc/cdns/swerv/Kconfig"
osource "/home/raul/iomico_inter/zephyr-intermediate/zephyr/soc/cdns/sample_controller32/Kconfig"
osource "/home/raul/iomico_inter/zephyr-intermediate/zephyr/soc/cdns/dc233c/Kconfig"
osource "/home/raul/iomico_inter/zephyr-intermediate/zephyr/soc/brcm/bcmvk/Kconfig"
osource "/home/raul/iomico_inter/zephyr-intermediate/zephyr/soc/brcm/bcm2712/Kconfig"
osource "/home/raul/iomico_inter/zephyr-intermediate/zephyr/soc/brcm/bcm2711/Kconfig"
osource "/home/raul/iomico_inter/zephyr-intermediate/zephyr/soc/blackberry/qnxhv_vm/Kconfig"
osource "/home/raul/iomico_inter/zephyr-intermediate/zephyr/soc/bflb/Kconfig"
osource "/home/raul/iomico_inter/zephyr-intermediate/zephyr/soc/atmel/sam0/Kconfig"
osource "/home/raul/iomico_inter/zephyr-intermediate/zephyr/soc/atmel/sam/Kconfig"
osource "/home/raul/iomico_inter/zephyr-intermediate/zephyr/soc/aspeed/Kconfig"
osource "/home/raul/iomico_inter/zephyr-intermediate/zephyr/soc/arm/Kconfig"
osource "/home/raul/iomico_inter/zephyr-intermediate/zephyr/soc/arm/beetle/Kconfig"
osource "/home/raul/iomico_inter/zephyr-intermediate/zephyr/soc/antmicro/myra/Kconfig"
osource "/home/raul/iomico_inter/zephyr-intermediate/zephyr/soc/andestech/Kconfig"
osource "/home/raul/iomico_inter/zephyr-intermediate/zephyr/soc/amd/acp_6_0/Kconfig"
osource "/home/raul/iomico_inter/zephyr-intermediate/zephyr/soc/ambiq/Kconfig"
osource "/home/raul/iomico_inter/zephyr-intermediate/zephyr/soc/allwinner/sun8i_h3/Kconfig"
osource "/home/raul/iomico_inter/zephyr-intermediate/zephyr/soc/alif/ensemble/Kconfig"
osource "/home/raul/iomico_inter/zephyr-intermediate/zephyr/soc/aesc/Kconfig"
osource "/home/raul/iomico_inter/zephyr-intermediate/zephyr/soc/adi/max32/Kconfig"
```
